## config/west.yml
```yaml
manifest:
  remotes:
    - name: zmkfirmware
      url-base: https://github.com/zmkfirmware
    - name: refil
      url-base: https://github.com/refil
  projects:
    - name: zmk
      remote: refil
      revision: f1d5fc736bdbdde11df0ec77114c6a398ee1252b # audited adv360-z3.5-2; no upgrade
      import: app/west.yml
  self:
    path: config
```
